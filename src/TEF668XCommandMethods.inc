// GENERATED by tools/gen_commands.py from tools/commands.py - do not edit.
// Included inside class TEF668X (public section). Level L1: one typed function per
// user-manual command. Every call goes through write(), which checks the parameter
// ranges, the chip variant and the device state before anything is sent.

/**
 * @brief Bandwidth and timing used during an AF_Update tune.
 * @details FM cmd 2, user manual 3.2.
 * @param autoBandwidth automatic IF bandwidth during AF_Update [0 ... 1, default FM 0]
 * @param bandwidth fixed IF bandwidth during AF_Update [560 ... 3110 0.1 kHz, default FM 2360]
 * @param muteTime mute slope time [250 ... 1000 us, default FM 1000]
 * @param sampleTime quality sampling time (>= 2 ms advised) [1000 ... 20000 us, default FM 2000]
 * @return Error::Ok, or why the write was refused (Error::OutOfRange: see lastErrorParam()).
 */
Error setTuneOptions(bool autoBandwidth, uint16_t bandwidth, uint16_t muteTime, uint16_t sampleTime) {
  const int16_t p[] = {static_cast<int16_t>(autoBandwidth), static_cast<int16_t>(bandwidth), static_cast<int16_t>(muteTime), static_cast<int16_t>(sampleTime)};
  return write(tef::Cmd::FmTuneOptions, p, 4);
}

/**
 * @brief FM IF bandwidth (PACS). Auto narrows the filter when adjacent stations are strong.
 * @details FM cmd 10, user manual 3.3.
 * Sends the 4 standard parameters; the extended ones keep their value (use setFmBandwidthExt() to set them).
 * @param autoMode true = automatic bandwidth, false = fixed [0 ... 1, default FM 1]
 * @param bandwidth fixed bandwidth (used when autoMode = false) [560 ... 3110 0.1 kHz, default FM 2360]
 * @param sensitivity adjacent channel sensitivity of the auto control [500 ... 1500 0.1 %, default FM 1000]
 * @param lowLevelSensitivity same, for weak signals [500 ... 1500 0.1 %, default FM 1000]
 * @return Error::Ok, or why the write was refused (Error::OutOfRange: see lastErrorParam()).
 */
Error setFmBandwidth(bool autoMode, uint16_t bandwidth, uint16_t sensitivity, uint16_t lowLevelSensitivity) {
  const int16_t p[] = {static_cast<int16_t>(autoMode), static_cast<int16_t>(bandwidth), static_cast<int16_t>(sensitivity), static_cast<int16_t>(lowLevelSensitivity)};
  return write(tef::Cmd::FmBandwidth, p, 4);
}

/**
 * @brief FM IF bandwidth (PACS). Auto narrows the filter when adjacent stations are strong.
 * @details FM cmd 10, user manual 3.3.
 * @param autoMode true = automatic bandwidth, false = fixed [0 ... 1, default FM 1]
 * @param bandwidth fixed bandwidth (used when autoMode = false) [560 ... 3110 0.1 kHz, default FM 2360]
 * @param sensitivity adjacent channel sensitivity of the auto control [500 ... 1500 0.1 %, default FM 1000]
 * @param lowLevelSensitivity same, for weak signals [500 ... 1500 0.1 %, default FM 1000]
 * @param minBandwidth extended: narrowest auto bandwidth (raise for 200 kHz grids) [560 ... 1140 0.1 kHz, default FM 560]
 * @param nominalBandwidth extended: bandwidth with no disturbance [1510 ... 2360 0.1 kHz, default FM 2360]
 * @param controlAttack extended: wide-to-narrow attack time [150 ... 450 us, default FM 300]
 * @return Error::Ok, or why the write was refused (Error::OutOfRange: see lastErrorParam()).
 */
Error setFmBandwidthExt(bool autoMode, uint16_t bandwidth, uint16_t sensitivity, uint16_t lowLevelSensitivity, uint16_t minBandwidth, uint16_t nominalBandwidth, uint16_t controlAttack) {
  const int16_t p[] = {static_cast<int16_t>(autoMode), static_cast<int16_t>(bandwidth), static_cast<int16_t>(sensitivity), static_cast<int16_t>(lowLevelSensitivity), static_cast<int16_t>(minBandwidth), static_cast<int16_t>(nominalBandwidth), static_cast<int16_t>(controlAttack)};
  return write(tef::Cmd::FmBandwidth, p, 7);
}

/**
 * @brief AM IF bandwidth (fixed).
 * @details AM cmd 10, user manual 3.3.
 * @param autoMode AM supports fixed only: pass false [0 ... 0, default AM 0]
 * @param bandwidth IF bandwidth 3 ... 8 kHz [30 ... 80 0.1 kHz, default AM 40]
 * @return Error::Ok, or why the write was refused (Error::OutOfRange: see lastErrorParam()).
 */
Error setAmBandwidth(bool autoMode, uint16_t bandwidth) {
  const int16_t p[] = {static_cast<int16_t>(autoMode), static_cast<int16_t>(bandwidth)};
  return write(tef::Cmd::AmBandwidth, p, 2);
}

/**
 * @brief FM RF AGC start level. Lower = less intermodulation, more desensitisation.
 * @details FM cmd 11, user manual 3.4.
 * @param start AGC start level [840 ... 920 0.1 dBuV, default FM 920]
 * @param extension use the external AGC step (needs a GPIO set to AgcStep) [0 ... 1, default FM 0]
 * @return Error::Ok, or why the write was refused (Error::OutOfRange: see lastErrorParam()).
 */
Error setFmRfAgc(uint16_t start, bool extension) {
  const int16_t p[] = {static_cast<int16_t>(start), static_cast<int16_t>(extension)};
  return write(tef::Cmd::FmRfAgc, p, 2);
}

/**
 * @brief AM RF AGC start level.
 * @details AM cmd 11, user manual 3.4.
 * @param start AGC start level [940 ... 1020 0.1 dBuV, default AM 1000]
 * @return Error::Ok, or why the write was refused (Error::OutOfRange: see lastErrorParam()).
 */
Error setAmRfAgc(uint16_t start) {
  const int16_t p[] = {static_cast<int16_t>(start)};
  return write(tef::Cmd::AmRfAgc, p, 1);
}

/**
 * @brief AM antenna attenuation (minimum AGC). 18-24 dB advised with an active antenna (AN11254 2.2).
 * @details AM cmd 12, user manual 3.5.
 * @param attenuation 0, 60, 120 ... 360 (6 dB steps) [0 ... 360 0.1 dB, default AM 0]
 * @return Error::Ok, or why the write was refused (Error::OutOfRange: see lastErrorParam()).
 */
Error setAntenna(uint16_t attenuation) {
  const int16_t p[] = {static_cast<int16_t>(attenuation)};
  return write(tef::Cmd::AmAntenna, p, 1);
}

/**
 * @brief AM co-channel detector; result in Quality::coChannel.
 * @details AM cmd 14, user manual 3.6.
 * @param enable detector on/off [0 ... 1, default AM 1]
 * @param restart none / manual now / automatic after tune [0 ... 2, default AM 2]
 * @param sensitivity detection sensitivity [500 ... 1500 0.1 %, default AM 1000]
 * @param count detections before it is reported [1 ... 15 counts, default AM 3]
 * @return Error::Ok, or why the write was refused (Error::OutOfRange: see lastErrorParam()).
 */
Error setCoChannelDet(bool enable, Restart restart, uint16_t sensitivity, uint16_t count) {
  const int16_t p[] = {static_cast<int16_t>(enable), static_cast<int16_t>(restart), static_cast<int16_t>(sensitivity), static_cast<int16_t>(count)};
  return write(tef::Cmd::AmCoChannelDet, p, 4);
}

/**
 * @brief FM multipath suppression (iMS). NXP advises on.
 * @details FM cmd 20, user manual 3.7.
 * @param enable multipath suppression on/off [0 ... 1, default FM 0]
 * @return Error::Ok, or why the write was refused (Error::OutOfRange: see lastErrorParam()).
 */
Error setMphSuppression(bool enable) {
  const int16_t p[] = {static_cast<int16_t>(enable)};
  return write(tef::Cmd::FmMphSuppression, p, 1);
}

/**
 * @brief FM channel equalizer. NXP advises on.
 * @details FM cmd 22, user manual 3.8.
 * @param enable channel equalizer on/off [0 ... 1, default FM 0]
 * @return Error::Ok, or why the write was refused (Error::OutOfRange: see lastErrorParam()).
 */
Error setChannelEqualizer(bool enable) {
  const int16_t p[] = {static_cast<int16_t>(enable)};
  return write(tef::Cmd::FmChannelEqualizer, p, 1);
}

/**
 * @brief FM noise blanker (ignition pulses).
 * @details FM cmd 23, user manual 3.9.
 * Sends the 2 standard parameters; the extended ones keep their value (use setFmNoiseBlankerExt() to set them).
 * @param enable noise blanker on/off [0 ... 1, default FM 1]
 * @param sensitivity trigger sensitivity [500 ... 1500 0.1 %, default FM 1000]
 * @return Error::Ok, or why the write was refused (Error::OutOfRange: see lastErrorParam()).
 */
Error setFmNoiseBlanker(bool enable, uint16_t sensitivity) {
  const int16_t p[] = {static_cast<int16_t>(enable), static_cast<int16_t>(sensitivity)};
  return write(tef::Cmd::FmNoiseBlanker, p, 2);
}

/**
 * @brief FM noise blanker (ignition pulses).
 * @details FM cmd 23, user manual 3.9.
 * @param enable noise blanker on/off [0 ... 1, default FM 1]
 * @param sensitivity trigger sensitivity [500 ... 1500 0.1 %, default FM 1000]
 * @param reserved reserved, pass 0 [0 ... 0, default FM 0]
 * @param modulation extended: modulation where sensitivity is minimum [160 ... 1660 0.1 %, default FM 900]
 * @param offset extended: fixed sensitivity threshold [0 ... 250 0.1 %, default FM 1]
 * @param attack extended: reference attack time [15 ... 1200 us, default FM 140]
 * @param decay extended: reference decay time [300 ... 6000 us, default FM 2800]
 * @return Error::Ok, or why the write was refused (Error::OutOfRange: see lastErrorParam()).
 */
Error setFmNoiseBlankerExt(bool enable, uint16_t sensitivity, uint16_t reserved, uint16_t modulation, uint16_t offset, uint16_t attack, uint16_t decay) {
  const int16_t p[] = {static_cast<int16_t>(enable), static_cast<int16_t>(sensitivity), static_cast<int16_t>(reserved), static_cast<int16_t>(modulation), static_cast<int16_t>(offset), static_cast<int16_t>(attack), static_cast<int16_t>(decay)};
  return write(tef::Cmd::FmNoiseBlanker, p, 7);
}

/**
 * @brief AM IF noise blanker.
 * @details AM cmd 23, user manual 3.11.
 * Sends the 2 standard parameters; the extended ones keep their value (use setAmNoiseBlankerExt() to set them).
 * @param enable noise blanker on/off [0 ... 1, default AM 1]
 * @param sensitivity trigger sensitivity [500 ... 1500 0.1 %, default AM 1000]
 * @return Error::Ok, or why the write was refused (Error::OutOfRange: see lastErrorParam()).
 */
Error setAmNoiseBlanker(bool enable, uint16_t sensitivity) {
  const int16_t p[] = {static_cast<int16_t>(enable), static_cast<int16_t>(sensitivity)};
  return write(tef::Cmd::AmNoiseBlanker, p, 2);
}

/**
 * @brief AM IF noise blanker.
 * @details AM cmd 23, user manual 3.11.
 * @param enable noise blanker on/off [0 ... 1, default AM 1]
 * @param sensitivity trigger sensitivity [500 ... 1500 0.1 %, default AM 1000]
 * @param gain extended: trigger gain [600 ... 1600 0.1 %, default AM 1000]
 * @param blankTime extended: pulse stretch time [25 ... 250 us, default AM 56]
 * @return Error::Ok, or why the write was refused (Error::OutOfRange: see lastErrorParam()).
 */
Error setAmNoiseBlankerExt(bool enable, uint16_t sensitivity, uint16_t gain, uint16_t blankTime) {
  const int16_t p[] = {static_cast<int16_t>(enable), static_cast<int16_t>(sensitivity), static_cast<int16_t>(gain), static_cast<int16_t>(blankTime)};
  return write(tef::Cmd::AmNoiseBlanker, p, 4);
}

/**
 * @brief FM noise blanker blank times.
 * @details FM cmd 24, user manual 3.10.
 * @param blankTime blank time on low modulation (>= blankTime2) [75 ... 300 us, default FM 210]
 * @param blankTime2 blank time on high modulation [75 ... 300 us, default FM 210]
 * @param blankModulation modulation where blankTime2 applies [160 ... 1660 0.1 %, default FM 250]
 * @return Error::Ok, or why the write was refused (Error::OutOfRange: see lastErrorParam()).
 */
Error setNoiseBlankerOptions(uint16_t blankTime, uint16_t blankTime2, uint16_t blankModulation) {
  const int16_t p[] = {static_cast<int16_t>(blankTime), static_cast<int16_t>(blankTime2), static_cast<int16_t>(blankModulation)};
  return write(tef::Cmd::FmNoiseBlankerOptions, p, 3);
}

/**
 * @brief AM audio noise blanker (after demodulation).
 * @details AM cmd 24, user manual 3.12.
 * Sends the 2 standard parameters; the extended ones keep their value (use setNoiseBlankerAudioExt() to set them).
 * @param enable audio noise blanker on/off [0 ... 1, default AM 1]
 * @param sensitivity trigger sensitivity [500 ... 1500 0.1 %, default AM 1000]
 * @return Error::Ok, or why the write was refused (Error::OutOfRange: see lastErrorParam()).
 */
Error setNoiseBlankerAudio(bool enable, uint16_t sensitivity) {
  const int16_t p[] = {static_cast<int16_t>(enable), static_cast<int16_t>(sensitivity)};
  return write(tef::Cmd::AmNoiseBlankerAudio, p, 2);
}

/**
 * @brief AM audio noise blanker (after demodulation).
 * @details AM cmd 24, user manual 3.12.
 * @param enable audio noise blanker on/off [0 ... 1, default AM 1]
 * @param sensitivity trigger sensitivity [500 ... 1500 0.1 %, default AM 1000]
 * @param reserved reserved, pass 0 [0 ... 0, default AM 0]
 * @param blankTime extended: pulse stretch time [400 ... 1200 us, default AM 800]
 * @return Error::Ok, or why the write was refused (Error::OutOfRange: see lastErrorParam()).
 */
Error setNoiseBlankerAudioExt(bool enable, uint16_t sensitivity, uint16_t reserved, uint16_t blankTime) {
  const int16_t p[] = {static_cast<int16_t>(enable), static_cast<int16_t>(sensitivity), static_cast<int16_t>(reserved), static_cast<int16_t>(blankTime)};
  return write(tef::Cmd::AmNoiseBlankerAudio, p, 4);
}

/**
 * @brief Enable the digital radio (HD/DRM) baseband output.
 * @details FM/AM cmd 30, user manual 3.13. TEF6688/TEF6689 only.
 * @param band Band::FM or Band::AM (the AM settings are used while AM is tuned).
 * @param enable digital radio on/off [0 ... 1, default FM 0 / AM 0]
 * @return Error::Ok, or why the write was refused (Error::OutOfRange: see lastErrorParam()).
 */
Error setDigitalRadio(Band band, bool enable) {
  const int16_t p[] = {static_cast<int16_t>(enable)};
  return write(band == Band::FM ? tef::Cmd::FmDigitalRadio : tef::Cmd::AmDigitalRadio, p, 1);
}

/**
 * @brief FM de-emphasis: 50 us (Europe/Asia) or 75 us (Americas).
 * @details FM cmd 31, user manual 3.14.
 * @param timeConstant Off / Us50 / Us75 [0 ... 750, default FM 500]
 * @return Error::Ok, or why the write was refused (Error::OutOfRange: see lastErrorParam()).
 */
Error setDeemphasis(Deemphasis timeConstant) {
  const int16_t p[] = {static_cast<int16_t>(timeConstant)};
  return write(tef::Cmd::FmDeemphasis, p, 1);
}

/**
 * @brief Select stereo high blend or FMSI band blend. NXP advises FMSI.
 * @details FM cmd 32, user manual 3.15. TEF6687/TEF6689 only.
 * @param fmsi true = FMSI, false = stereo high blend [0 ... 1, default FM 0]
 * @return Error::Ok, or why the write was refused (Error::OutOfRange: see lastErrorParam()).
 */
Error setStereoImprovement(bool fmsi) {
  const int16_t p[] = {static_cast<int16_t>(fmsi)};
  return write(tef::Cmd::FmStereoImprovement, p, 1);
}

/**
 * @brief Level reading correction per AGC step (not advised to change).
 * @details FM/AM cmd 38, user manual 3.16.
 * @param band Band::FM or Band::AM (the AM settings are used while AM is tuned).
 * @param step1 level correction for AGC step 1 [-60 ... 0 0.1 dB, default FM -20 / AM -10]
 * @param step2 level correction for AGC step 2 [-60 ... 0 0.1 dB, default FM -30 / AM -20]
 * @param step3 level correction for AGC step 3 [-60 ... 0 0.1 dB, default FM -40 / AM -30]
 * @param step4 level correction for AGC step 4 [-60 ... 0 0.1 dB, default FM -50 / AM -40]
 * @param step5 level correction for AGC step 5 [-60 ... 0 0.1 dB, default FM -60 / AM -50]
 * @param step6 level correction for AGC step 6 [-60 ... 0 0.1 dB, default FM -60 / AM -60]
 * @param step7 level correction for AGC step 7 [-60 ... 0 0.1 dB, default FM -60 / AM -60]
 * @return Error::Ok, or why the write was refused (Error::OutOfRange: see lastErrorParam()).
 */
Error setLevelStep(Band band, int16_t step1, int16_t step2, int16_t step3, int16_t step4, int16_t step5, int16_t step6, int16_t step7) {
  const int16_t p[] = {static_cast<int16_t>(step1), static_cast<int16_t>(step2), static_cast<int16_t>(step3), static_cast<int16_t>(step4), static_cast<int16_t>(step5), static_cast<int16_t>(step6), static_cast<int16_t>(step7)};
  return write(band == Band::FM ? tef::Cmd::FmLevelStep : tef::Cmd::AmLevelStep, p, 7);
}

/**
 * @brief Level reading offset (e.g. active antenna gain; <= -7 dB with strong active antennas).
 * @details FM/AM cmd 39, user manual 3.17.
 * @param band Band::FM or Band::AM (the AM settings are used while AM is tuned).
 * @param offset offset added to the level detector [-480 ... 150 0.1 dB, default FM 0 / AM 0]
 * @return Error::Ok, or why the write was refused (Error::OutOfRange: see lastErrorParam()).
 */
Error setLevelOffset(Band band, int16_t offset) {
  const int16_t p[] = {static_cast<int16_t>(offset)};
  return write(band == Band::FM ? tef::Cmd::FmLevelOffset : tef::Cmd::AmLevelOffset, p, 1);
}

/**
 * @brief SoftMute response times (slow and fast timer).
 * @details FM/AM cmd 40, user manual 3.18.
 * @param band Band::FM or Band::AM (the AM settings are used while AM is tuned).
 * @param slowAttack slow attack time [60 ... 2000 ms, default FM 120 / AM 120]
 * @param slowDecay slow decay time [120 ... 12500 ms, default FM 500 / AM 500]
 * @param fastAttack fast attack time [10 ... 1200 0.1 ms, default FM 20 / AM 120]
 * @param fastDecay fast decay time [20 ... 5000 0.1 ms, default FM 20 / AM 500]
 * @return Error::Ok, or why the write was refused (Error::OutOfRange: see lastErrorParam()).
 */
Error setSoftmuteTime(Band band, uint16_t slowAttack, uint16_t slowDecay, uint16_t fastAttack, uint16_t fastDecay) {
  const int16_t p[] = {static_cast<int16_t>(slowAttack), static_cast<int16_t>(slowDecay), static_cast<int16_t>(fastAttack), static_cast<int16_t>(fastDecay)};
  return write(band == Band::FM ? tef::Cmd::FmSoftmuteTime : tef::Cmd::AmSoftmuteTime, p, 4);
}

/**
 * @brief AM SoftMute modulation dependency.
 * @details AM cmd 41, user manual 3.18.
 * @param enable modulation dependent control on/off [0 ... 1, default AM 0]
 * @param start control starts when modulation falls below [100 ... 1000 0.1 %, default AM 210]
 * @param slope modulation range of the control [30 ... 1000 0.1 %, default AM 120]
 * @param shift maximum extra control shift [50 ... 1000 0.1 %, default AM 260]
 * @return Error::Ok, or why the write was refused (Error::OutOfRange: see lastErrorParam()).
 */
Error setSoftmuteMod(bool enable, uint16_t start, uint16_t slope, uint16_t shift) {
  const int16_t p[] = {static_cast<int16_t>(enable), static_cast<int16_t>(start), static_cast<int16_t>(slope), static_cast<int16_t>(shift)};
  return write(tef::Cmd::AmSoftmuteMod, p, 4);
}

/**
 * @brief SoftMute on RF level: volume goes down below `start`.
 * @details FM/AM cmd 42, user manual 3.18.
 * @param band Band::FM or Band::AM (the AM settings are used while AM is tuned).
 * @param mode off / fast / slow / dual timer [0 ... 3, default FM 2 / AM 2]
 * @param start control starts when the RF level crosses this [0 ... 500 0.1 dBuV, default FM 150 / AM 280]
 * @param slope range over which the control goes from 0 to 100 % [60 ... 300 0.1 dB, default FM 220 / AM 250]
 * @return Error::Ok, or why the write was refused (Error::OutOfRange: see lastErrorParam()).
 */
Error setSoftmuteLevel(Band band, WshMode mode, uint16_t start, uint16_t slope) {
  const int16_t p[] = {static_cast<int16_t>(mode), static_cast<int16_t>(start), static_cast<int16_t>(slope)};
  return write(band == Band::FM ? tef::Cmd::FmSoftmuteLevel : tef::Cmd::AmSoftmuteLevel, p, 3);
}

/**
 * @brief FM SoftMute on ultrasonic noise (USN).
 * @details FM cmd 43, user manual 3.18.
 * @param mode off / fast / slow / dual timer [0 ... 3, default FM 0]
 * @param start control starts when USN noise crosses this [0 ... 800 0.1 %, default FM 500]
 * @param slope range over which the control goes from 0 to 100 % [100 ... 1000 0.1 %, default FM 1000]
 * @return Error::Ok, or why the write was refused (Error::OutOfRange: see lastErrorParam()).
 */
Error setSoftmuteNoise(WshMode mode, uint16_t start, uint16_t slope) {
  const int16_t p[] = {static_cast<int16_t>(mode), static_cast<int16_t>(start), static_cast<int16_t>(slope)};
  return write(tef::Cmd::FmSoftmuteNoise, p, 3);
}

/**
 * @brief FM SoftMute on multipath (WAM).
 * @details FM cmd 44, user manual 3.18.
 * @param mode off / fast / slow / dual timer [0 ... 3, default FM 0]
 * @param start control starts when WAM multipath crosses this [0 ... 800 0.1 %, default FM 500]
 * @param slope range over which the control goes from 0 to 100 % [100 ... 1000 0.1 %, default FM 1000]
 * @return Error::Ok, or why the write was refused (Error::OutOfRange: see lastErrorParam()).
 */
Error setSoftmuteMph(WshMode mode, uint16_t start, uint16_t slope) {
  const int16_t p[] = {static_cast<int16_t>(mode), static_cast<int16_t>(start), static_cast<int16_t>(slope)};
  return write(tef::Cmd::FmSoftmuteMph, p, 3);
}

/**
 * @brief Maximum SoftMute attenuation.
 * @details FM/AM cmd 45, user manual 3.18.
 * @param band Band::FM or Band::AM (the AM settings are used while AM is tuned).
 * @param enable dynamic control on (off = evaluation only) [0 ... 1, default FM 1 / AM 1]
 * @param limit maximum attenuation [0 ... 400 0.1 dB, default FM 200 / AM 250]
 * @return Error::Ok, or why the write was refused (Error::OutOfRange: see lastErrorParam()).
 */
Error setSoftmuteMax(Band band, bool enable, uint16_t limit) {
  const int16_t p[] = {static_cast<int16_t>(enable), static_cast<int16_t>(limit)};
  return write(band == Band::FM ? tef::Cmd::FmSoftmuteMax : tef::Cmd::AmSoftmuteMax, p, 2);
}

/**
 * @brief HighCut response times.
 * @details FM/AM cmd 50, user manual 3.19.
 * @param band Band::FM or Band::AM (the AM settings are used while AM is tuned).
 * @param slowAttack slow attack time [60 ... 2000 ms, default FM 500 / AM 500]
 * @param slowDecay slow decay time [120 ... 12500 ms, default FM 2000 / AM 2000]
 * @param fastAttack fast attack time [10 ... 1200 0.1 ms, default FM 20 / AM 120]
 * @param fastDecay fast decay time [20 ... 5000 0.1 ms, default FM 20 / AM 500]
 * @return Error::Ok, or why the write was refused (Error::OutOfRange: see lastErrorParam()).
 */
Error setHighcutTime(Band band, uint16_t slowAttack, uint16_t slowDecay, uint16_t fastAttack, uint16_t fastDecay) {
  const int16_t p[] = {static_cast<int16_t>(slowAttack), static_cast<int16_t>(slowDecay), static_cast<int16_t>(fastAttack), static_cast<int16_t>(fastDecay)};
  return write(band == Band::FM ? tef::Cmd::FmHighcutTime : tef::Cmd::AmHighcutTime, p, 4);
}

/**
 * @brief HighCut modulation dependency.
 * @details FM/AM cmd 51, user manual 3.19.
 * @param band Band::FM or Band::AM (the AM settings are used while AM is tuned).
 * @param enable modulation dependent control on/off [0 ... 1, default FM 0 / AM 0]
 * @param start control starts when modulation falls below [100 ... 1000 0.1 %, default FM 250 / AM 250]
 * @param slope modulation range of the control [30 ... 1000 0.1 %, default FM 130 / AM 130]
 * @param shift maximum extra control shift [50 ... 1000 0.1 %, default FM 500 / AM 500]
 * @return Error::Ok, or why the write was refused (Error::OutOfRange: see lastErrorParam()).
 */
Error setHighcutMod(Band band, bool enable, uint16_t start, uint16_t slope, uint16_t shift) {
  const int16_t p[] = {static_cast<int16_t>(enable), static_cast<int16_t>(start), static_cast<int16_t>(slope), static_cast<int16_t>(shift)};
  return write(band == Band::FM ? tef::Cmd::FmHighcutMod : tef::Cmd::AmHighcutMod, p, 4);
}

/**
 * @brief HighCut on RF level: treble is cut below `start`.
 * @details FM/AM cmd 52, user manual 3.19.
 * @param band Band::FM or Band::AM (the AM settings are used while AM is tuned).
 * @param mode off / fast / slow / dual timer [0 ... 3, default FM 3 / AM 2]
 * @param start control starts when the RF level crosses this [200 ... 600 0.1 dBuV, default FM 360 / AM 400]
 * @param slope range over which the control goes from 0 to 100 % [60 ... 300 0.1 dB, default FM 300 / AM 200]
 * @return Error::Ok, or why the write was refused (Error::OutOfRange: see lastErrorParam()).
 */
Error setHighcutLevel(Band band, WshMode mode, uint16_t start, uint16_t slope) {
  const int16_t p[] = {static_cast<int16_t>(mode), static_cast<int16_t>(start), static_cast<int16_t>(slope)};
  return write(band == Band::FM ? tef::Cmd::FmHighcutLevel : tef::Cmd::AmHighcutLevel, p, 3);
}

/**
 * @brief FM HighCut on ultrasonic noise.
 * @details FM cmd 53, user manual 3.19.
 * @param mode off / fast / slow / dual timer [0 ... 3, default FM 2]
 * @param start control starts when USN noise crosses this [0 ... 800 0.1 %, default FM 360]
 * @param slope range over which the control goes from 0 to 100 % [100 ... 1000 0.1 %, default FM 300]
 * @return Error::Ok, or why the write was refused (Error::OutOfRange: see lastErrorParam()).
 */
Error setHighcutNoise(WshMode mode, uint16_t start, uint16_t slope) {
  const int16_t p[] = {static_cast<int16_t>(mode), static_cast<int16_t>(start), static_cast<int16_t>(slope)};
  return write(tef::Cmd::FmHighcutNoise, p, 3);
}

/**
 * @brief FM HighCut on multipath.
 * @details FM cmd 54, user manual 3.19.
 * @param mode off / fast / slow / dual timer [0 ... 3, default FM 2]
 * @param start control starts when WAM multipath crosses this [0 ... 800 0.1 %, default FM 360]
 * @param slope range over which the control goes from 0 to 100 % [100 ... 1000 0.1 %, default FM 300]
 * @return Error::Ok, or why the write was refused (Error::OutOfRange: see lastErrorParam()).
 */
Error setHighcutMph(WshMode mode, uint16_t start, uint16_t slope) {
  const int16_t p[] = {static_cast<int16_t>(mode), static_cast<int16_t>(start), static_cast<int16_t>(slope)};
  return write(tef::Cmd::FmHighcutMph, p, 3);
}

/**
 * @brief Strongest HighCut (lowest -3 dB frequency). Range depends on setHighcutOptions().
 * @details FM/AM cmd 55, user manual 3.19.
 * @param band Band::FM or Band::AM (the AM settings are used while AM is tuned).
 * @param enable dynamic control on [0 ... 1, default FM 1 / AM 1]
 * @param limit IIR 1500-7000, deemphasis 700-3000, FIR 2700-7000 [700 ... 7000 Hz, default FM 4000 / AM 1800]
 * @return Error::Ok, or why the write was refused (Error::OutOfRange: see lastErrorParam()).
 */
Error setHighcutMax(Band band, bool enable, uint16_t limit) {
  const int16_t p[] = {static_cast<int16_t>(enable), static_cast<int16_t>(limit)};
  return write(band == Band::FM ? tef::Cmd::FmHighcutMax : tef::Cmd::AmHighcutMax, p, 2);
}

/**
 * @brief HighCut kept on good signals (fixed limit).
 * @details FM/AM cmd 56, user manual 3.19.
 * @param band Band::FM or Band::AM (the AM settings are used while AM is tuned).
 * @param enable limit on/off [0 ... 1, default FM 0 / AM 1]
 * @param limit IIR/FIR 2700-15000, deemphasis 1500-3183 [1500 ... 15000 Hz, default FM 10000 / AM 6000]
 * @return Error::Ok, or why the write was refused (Error::OutOfRange: see lastErrorParam()).
 */
Error setHighcutMin(Band band, bool enable, uint16_t limit) {
  const int16_t p[] = {static_cast<int16_t>(enable), static_cast<int16_t>(limit)};
  return write(band == Band::FM ? tef::Cmd::FmHighcutMin : tef::Cmd::AmHighcutMin, p, 2);
}

/**
 * @brief Strongest dynamic LowCut (shares HighCut timing and sensitivity).
 * @details FM/AM cmd 57, user manual 3.19.
 * @param band Band::FM or Band::AM (the AM settings are used while AM is tuned).
 * @param enable dynamic control on [0 ... 1, default FM 1 / AM 1]
 * @param limit -3 dB frequency at maximum LowCut [30 ... 500 Hz, default FM 120 / AM 120]
 * @return Error::Ok, or why the write was refused (Error::OutOfRange: see lastErrorParam()).
 */
Error setLowcutMax(Band band, bool enable, uint16_t limit) {
  const int16_t p[] = {static_cast<int16_t>(enable), static_cast<int16_t>(limit)};
  return write(band == Band::FM ? tef::Cmd::FmLowcutMax : tef::Cmd::AmLowcutMax, p, 2);
}

/**
 * @brief LowCut kept on good signals.
 * @details FM/AM cmd 58, user manual 3.19.
 * @param band Band::FM or Band::AM (the AM settings are used while AM is tuned).
 * @param enable limit on/off [0 ... 1, default FM 0 / AM 1]
 * @param limit -3 dB frequency at minimum LowCut [10 ... 200 Hz, default FM 20 / AM 20]
 * @return Error::Ok, or why the write was refused (Error::OutOfRange: see lastErrorParam()).
 */
Error setLowcutMin(Band band, bool enable, uint16_t limit) {
  const int16_t p[] = {static_cast<int16_t>(enable), static_cast<int16_t>(limit)};
  return write(band == Band::FM ? tef::Cmd::FmLowcutMin : tef::Cmd::AmLowcutMin, p, 2);
}

/**
 * @brief HighCut filter type. Deemphasis type ignores setDeemphasis().
 * @details FM cmd 59, user manual 3.19.
 * @param filter Iir / Deemphasis / Fir [1 ... 3, default FM 1]
 * @return Error::Ok, or why the write was refused (Error::OutOfRange: see lastErrorParam()).
 */
Error setHighcutOptions(HighcutFilter filter) {
  const int16_t p[] = {static_cast<int16_t>(filter)};
  return write(tef::Cmd::FmHighcutOptions, p, 1);
}

/**
 * @brief Stereo blend response times.
 * @details FM cmd 60, user manual 3.20.
 * @param slowAttack slow attack time [60 ... 2000 ms, default FM 1000]
 * @param slowDecay slow decay time [120 ... 12500 ms, default FM 4000]
 * @param fastAttack fast attack time [10 ... 1200 0.1 ms, default FM 20]
 * @param fastDecay fast decay time [20 ... 5000 0.1 ms, default FM 80]
 * @return Error::Ok, or why the write was refused (Error::OutOfRange: see lastErrorParam()).
 */
Error setStereoTime(uint16_t slowAttack, uint16_t slowDecay, uint16_t fastAttack, uint16_t fastDecay) {
  const int16_t p[] = {static_cast<int16_t>(slowAttack), static_cast<int16_t>(slowDecay), static_cast<int16_t>(fastAttack), static_cast<int16_t>(fastDecay)};
  return write(tef::Cmd::FmStereoTime, p, 4);
}

/**
 * @brief Stereo blend modulation dependency.
 * @details FM cmd 61, user manual 3.20.
 * @param enable modulation dependent control on/off [0 ... 1, default FM 0]
 * @param start control starts when modulation falls below [100 ... 1000 0.1 %, default FM 210]
 * @param slope modulation range of the control [30 ... 1000 0.1 %, default FM 90]
 * @param shift maximum extra control shift [50 ... 1000 0.1 %, default FM 500]
 * @return Error::Ok, or why the write was refused (Error::OutOfRange: see lastErrorParam()).
 */
Error setStereoMod(bool enable, uint16_t start, uint16_t slope, uint16_t shift) {
  const int16_t p[] = {static_cast<int16_t>(enable), static_cast<int16_t>(start), static_cast<int16_t>(slope), static_cast<int16_t>(shift)};
  return write(tef::Cmd::FmStereoMod, p, 4);
}

/**
 * @brief Stereo blend on RF level: goes to mono below `start`.
 * @details FM cmd 62, user manual 3.20.
 * @param mode off / fast / slow / dual timer [0 ... 3, default FM 3]
 * @param start control starts when the RF level crosses this [300 ... 600 0.1 dBuV, default FM 460]
 * @param slope range over which the control goes from 0 to 100 % [60 ... 300 0.1 dB, default FM 240]
 * @return Error::Ok, or why the write was refused (Error::OutOfRange: see lastErrorParam()).
 */
Error setStereoLevel(WshMode mode, uint16_t start, uint16_t slope) {
  const int16_t p[] = {static_cast<int16_t>(mode), static_cast<int16_t>(start), static_cast<int16_t>(slope)};
  return write(tef::Cmd::FmStereoLevel, p, 3);
}

/**
 * @brief Stereo blend on ultrasonic noise.
 * @details FM cmd 63, user manual 3.20.
 * @param mode off / fast / slow / dual timer [0 ... 3, default FM 3]
 * @param start control starts when USN noise crosses this [0 ... 800 0.1 %, default FM 240]
 * @param slope range over which the control goes from 0 to 100 % [100 ... 1000 0.1 %, default FM 200]
 * @return Error::Ok, or why the write was refused (Error::OutOfRange: see lastErrorParam()).
 */
Error setStereoNoise(WshMode mode, uint16_t start, uint16_t slope) {
  const int16_t p[] = {static_cast<int16_t>(mode), static_cast<int16_t>(start), static_cast<int16_t>(slope)};
  return write(tef::Cmd::FmStereoNoise, p, 3);
}

/**
 * @brief Stereo blend on multipath.
 * @details FM cmd 64, user manual 3.20.
 * @param mode off / fast / slow / dual timer [0 ... 3, default FM 3]
 * @param start control starts when WAM multipath crosses this [0 ... 800 0.1 %, default FM 240]
 * @param slope range over which the control goes from 0 to 100 % [100 ... 1000 0.1 %, default FM 200]
 * @return Error::Ok, or why the write was refused (Error::OutOfRange: see lastErrorParam()).
 */
Error setStereoMph(WshMode mode, uint16_t start, uint16_t slope) {
  const int16_t p[] = {static_cast<int16_t>(mode), static_cast<int16_t>(start), static_cast<int16_t>(slope)};
  return write(tef::Cmd::FmStereoMph, p, 3);
}

/**
 * @brief Allow full blend to mono (off = evaluation only).
 * @details FM cmd 65, user manual 3.20.
 * @param enable dynamic stereo control on [0 ... 1, default FM 1]
 * @return Error::Ok, or why the write was refused (Error::OutOfRange: see lastErrorParam()).
 */
Error setStereoMax(bool enable) {
  const int16_t p[] = {static_cast<int16_t>(enable)};
  return write(tef::Cmd::FmStereoMax, p, 1);
}

/**
 * @brief Stereo limit on good signals, or forced mono.
 * @details FM cmd 66, user manual 3.20.
 * @param mode Off / Limit / ForcedMono [0 ... 2, default FM 0]
 * @param limit minimum channel separation when mode = Limit [60 ... 400 0.1 dB, default FM 400]
 * @return Error::Ok, or why the write was refused (Error::OutOfRange: see lastErrorParam()).
 */
Error setStereoMin(StereoMin mode, uint16_t limit) {
  const int16_t p[] = {static_cast<int16_t>(mode), static_cast<int16_t>(limit)};
  return write(tef::Cmd::FmStereoMin, p, 2);
}

/**
 * @brief Stereo high blend response times.
 * @details FM cmd 70, user manual 3.21.
 * @param slowAttack slow attack time [60 ... 2000 ms, default FM 500]
 * @param slowDecay slow decay time [120 ... 12500 ms, default FM 2000]
 * @param fastAttack fast attack time [10 ... 1200 0.1 ms, default FM 20]
 * @param fastDecay fast decay time [20 ... 5000 0.1 ms, default FM 20]
 * @return Error::Ok, or why the write was refused (Error::OutOfRange: see lastErrorParam()).
 */
Error setStHiBlendTime(uint16_t slowAttack, uint16_t slowDecay, uint16_t fastAttack, uint16_t fastDecay) {
  const int16_t p[] = {static_cast<int16_t>(slowAttack), static_cast<int16_t>(slowDecay), static_cast<int16_t>(fastAttack), static_cast<int16_t>(fastDecay)};
  return write(tef::Cmd::FmStHiBlendTime, p, 4);
}

/**
 * @brief Stereo high blend modulation dependency.
 * @details FM cmd 71, user manual 3.21.
 * @param enable modulation dependent control on/off [0 ... 1, default FM 0]
 * @param start control starts when modulation falls below [100 ... 1000 0.1 %, default FM 240]
 * @param slope modulation range of the control [30 ... 1000 0.1 %, default FM 120]
 * @param shift maximum extra control shift [50 ... 1000 0.1 %, default FM 670]
 * @return Error::Ok, or why the write was refused (Error::OutOfRange: see lastErrorParam()).
 */
Error setStHiBlendMod(bool enable, uint16_t start, uint16_t slope, uint16_t shift) {
  const int16_t p[] = {static_cast<int16_t>(enable), static_cast<int16_t>(start), static_cast<int16_t>(slope), static_cast<int16_t>(shift)};
  return write(tef::Cmd::FmStHiBlendMod, p, 4);
}

/**
 * @brief Stereo high blend on RF level.
 * @details FM cmd 72, user manual 3.21.
 * @param mode off / fast / slow / dual timer [0 ... 3, default FM 3]
 * @param start control starts when the RF level crosses this [300 ... 660 0.1 dBuV, default FM 600]
 * @param slope range over which the control goes from 0 to 100 % [60 ... 300 0.1 dB, default FM 240]
 * @return Error::Ok, or why the write was refused (Error::OutOfRange: see lastErrorParam()).
 */
Error setStHiBlendLevel(WshMode mode, uint16_t start, uint16_t slope) {
  const int16_t p[] = {static_cast<int16_t>(mode), static_cast<int16_t>(start), static_cast<int16_t>(slope)};
  return write(tef::Cmd::FmStHiBlendLevel, p, 3);
}

/**
 * @brief Stereo high blend on ultrasonic noise.
 * @details FM cmd 73, user manual 3.21.
 * @param mode off / fast / slow / dual timer [0 ... 3, default FM 3]
 * @param start control starts when USN noise crosses this [0 ... 800 0.1 %, default FM 160]
 * @param slope range over which the control goes from 0 to 100 % [100 ... 1000 0.1 %, default FM 140]
 * @return Error::Ok, or why the write was refused (Error::OutOfRange: see lastErrorParam()).
 */
Error setStHiBlendNoise(WshMode mode, uint16_t start, uint16_t slope) {
  const int16_t p[] = {static_cast<int16_t>(mode), static_cast<int16_t>(start), static_cast<int16_t>(slope)};
  return write(tef::Cmd::FmStHiBlendNoise, p, 3);
}

/**
 * @brief Stereo high blend on multipath.
 * @details FM cmd 74, user manual 3.21.
 * @param mode off / fast / slow / dual timer [0 ... 3, default FM 3]
 * @param start control starts when WAM multipath crosses this [0 ... 800 0.1 %, default FM 160]
 * @param slope range over which the control goes from 0 to 100 % [100 ... 1000 0.1 %, default FM 140]
 * @return Error::Ok, or why the write was refused (Error::OutOfRange: see lastErrorParam()).
 */
Error setStHiBlendMph(WshMode mode, uint16_t start, uint16_t slope) {
  const int16_t p[] = {static_cast<int16_t>(mode), static_cast<int16_t>(start), static_cast<int16_t>(slope)};
  return write(tef::Cmd::FmStHiBlendMph, p, 3);
}

/**
 * @brief Strongest reduction of the stereo bandwidth.
 * @details FM cmd 75, user manual 3.21.
 * @param enable dynamic control on [0 ... 1, default FM 1]
 * @param limit stereo bandwidth at maximum blend [2700 ... 7000 Hz, default FM 4000]
 * @return Error::Ok, or why the write was refused (Error::OutOfRange: see lastErrorParam()).
 */
Error setStHiBlendMax(bool enable, uint16_t limit) {
  const int16_t p[] = {static_cast<int16_t>(enable), static_cast<int16_t>(limit)};
  return write(tef::Cmd::FmStHiBlendMax, p, 2);
}

/**
 * @brief Stereo bandwidth limit on good signals (must be above Max).
 * @details FM cmd 76, user manual 3.21.
 * @param enable limit on/off [0 ... 1, default FM 0]
 * @param limit stereo bandwidth at minimum blend [3000 ... 15000 Hz, default FM 7000]
 * @return Error::Ok, or why the write was refused (Error::OutOfRange: see lastErrorParam()).
 */
Error setStHiBlendMin(bool enable, uint16_t limit) {
  const int16_t p[] = {static_cast<int16_t>(enable), static_cast<int16_t>(limit)};
  return write(tef::Cmd::FmStHiBlendMin, p, 2);
}

/**
 * @brief Radio audio level before volume.
 * @details FM/AM cmd 80, user manual 3.22.
 * @param band Band::FM or Band::AM (the AM settings are used while AM is tuned).
 * @param gain analog radio signal gain [-120 ... 60 0.1 dB, default FM 0 / AM 0]
 * @return Error::Ok, or why the write was refused (Error::OutOfRange: see lastErrorParam()).
 */
Error setScaler(Band band, int16_t gain) {
  const int16_t p[] = {static_cast<int16_t>(gain)};
  return write(band == Band::FM ? tef::Cmd::FmScaler : tef::Cmd::AmScaler, p, 1);
}

/**
 * @brief RDS decoder setup. Read data with TEF668XRds or readRds().
 * @details FM cmd 81, user manual 3.23.
 * @param mode Off / Decoder / Demodulator [0 ... 2, default FM 1]
 * @param restart None / Now / AfterTune [0 ... 2, default FM 2]
 * @param pin None / Davn (data-available on a GPIO) / Legacy2Wire [0 ... 4, default FM 0]
 * @return Error::Ok, or why the write was refused (Error::OutOfRange: see lastErrorParam()).
 */
Error setRds(RdsMode mode, Restart restart, RdsPin pin) {
  const int16_t p[] = {static_cast<int16_t>(mode), static_cast<int16_t>(restart), static_cast<int16_t>(pin)};
  return write(tef::Cmd::FmRds, p, 3);
}

/**
 * @brief Quality-ready flag after a tune, optionally on a GPIO (QSI).
 * @details FM/AM cmd 82, user manual 3.24.
 * @param band Band::FM or Band::AM (the AM settings are used while AM is tuned).
 * @param flagTime 0 = off, 10...320 = flag delay; +0x8000 = AF_Update flag [0 ... 65535 0.1 ms, default FM 0 / AM 0]
 * @param pin None / Gpio (output on a GPIO set to Qsi) [0 ... 2, default FM 0 / AM 0]
 * @return Error::Ok, or why the write was refused (Error::OutOfRange: see lastErrorParam()).
 */
Error setQualityStatus(Band band, uint16_t flagTime, QsiPin pin) {
  const int16_t p[] = {static_cast<int16_t>(flagTime), static_cast<int16_t>(pin)};
  return write(band == Band::FM ? tef::Cmd::FmQualityStatus : tef::Cmd::AmQualityStatus, p, 2);
}

/**
 * @brief Digital/analog radio blend control.
 * @details FM/AM cmd 83, user manual 3.25. TEF6688/TEF6689 only.
 * @param band Band::FM or Band::AM (the AM settings are used while AM is tuned).
 * @param mode Pin / PinInverted / ForceDigital / ForceAnalog [0 ... 3, default FM 0 / AM 0]
 * @param inTime blend time towards digital [10 ... 5000 0.1 ms, default FM 50 / AM 50]
 * @param outTime blend time towards analog [10 ... 5000 0.1 ms, default FM 50 / AM 50]
 * @param gain digital radio signal gain [-180 ... 60 0.1 dB, default FM 0 / AM 0]
 * @return Error::Ok, or why the write was refused (Error::OutOfRange: see lastErrorParam()).
 */
Error setDrBlend(Band band, DrBlend mode, uint16_t inTime, uint16_t outTime, int16_t gain) {
  const int16_t p[] = {static_cast<int16_t>(mode), static_cast<int16_t>(inTime), static_cast<int16_t>(outTime), static_cast<int16_t>(gain)};
  return write(band == Band::FM ? tef::Cmd::FmDrBlend : tef::Cmd::AmDrBlend, p, 4);
}

/**
 * @brief Digital radio baseband I2S options.
 * @details FM/AM cmd 84, user manual 3.26. TEF6688/TEF6689 only.
 * @param band Band::FM or Band::AM (the AM settings are used while AM is tuned).
 * @param sampleRate 0 = automatic, 6500, 6750 [0 ... 6750 0.1 kHz, default FM 0 / AM 0]
 * @param pinMode 34 standard voltage, 2 voltage, 4 open drain [0 ... 34, default FM 34 / AM 34]
 * @param format 16 = 3-wire, 4112 = 4-wire [16 ... 4112, default FM 4112 / AM 4112]
 * @return Error::Ok, or why the write was refused (Error::OutOfRange: see lastErrorParam()).
 */
Error setDrOptions(Band band, uint16_t sampleRate, uint16_t pinMode, uint16_t format) {
  const int16_t p[] = {static_cast<int16_t>(sampleRate), static_cast<int16_t>(pinMode), static_cast<int16_t>(format)};
  return write(band == Band::FM ? tef::Cmd::FmDrOptions : tef::Cmd::AmDrOptions, p, 3);
}

/**
 * @brief Special DAC outputs (MPX for a DARC decoder, DR/analog compare).
 * @details FM/AM cmd 85, user manual 3.27.
 * @param band Band::FM or Band::AM (the AM settings are used while AM is tuned).
 * @param anaOut Normal / Mpx / DigitalAnalog [0 ... 2, default FM 0 / AM 0]
 * @return Error::Ok, or why the write was refused (Error::OutOfRange: see lastErrorParam()).
 */
Error setSpecials(Band band, AnaOutSpecial anaOut) {
  const int16_t p[] = {static_cast<int16_t>(anaOut)};
  return write(band == Band::FM ? tef::Cmd::FmSpecials : tef::Cmd::AmSpecials, p, 1);
}

/**
 * @brief Modulation where the auto bandwidth opens fully.
 * @details FM cmd 86, user manual 3.28.
 * @param modulation modulation index for maximum bandwidth [660 ... 1330 0.1 %, default FM 950]
 * @return Error::Ok, or why the write was refused (Error::OutOfRange: see lastErrorParam()).
 */
Error setBandwidthOptions(uint16_t modulation) {
  const int16_t p[] = {static_cast<int16_t>(modulation)};
  return write(tef::Cmd::FmBandwidthOptions, p, 1);
}

/**
 * @brief FMSI band blend response times.
 * @details FM cmd 90, user manual 3.29. TEF6687/TEF6689 only.
 * @param attack time towards mono [10 ... 1000 ms, default FM 50]
 * @param decay time towards stereo [10 ... 1000 ms, default FM 50]
 * @return Error::Ok, or why the write was refused (Error::OutOfRange: see lastErrorParam()).
 */
Error setStBandBlendTime(uint16_t attack, uint16_t decay) {
  const int16_t p[] = {static_cast<int16_t>(attack), static_cast<int16_t>(decay)};
  return write(tef::Cmd::FmStBandBlendTime, p, 2);
}

/**
 * @brief FMSI control sensitivity per audio band.
 * @details FM cmd 91, user manual 3.29. TEF6687/TEF6689 only.
 * @param band1 low band [500 ... 1500 0.1 %, default FM 1000]
 * @param band2 2 kHz band [500 ... 1500 0.1 %, default FM 1000]
 * @param band3 5 kHz band [500 ... 1500 0.1 %, default FM 1000]
 * @param band4 high band [500 ... 1500 0.1 %, default FM 1000]
 * @return Error::Ok, or why the write was refused (Error::OutOfRange: see lastErrorParam()).
 */
Error setStBandBlendGain(uint16_t band1, uint16_t band2, uint16_t band3, uint16_t band4) {
  const int16_t p[] = {static_cast<int16_t>(band1), static_cast<int16_t>(band2), static_cast<int16_t>(band3), static_cast<int16_t>(band4)};
  return write(tef::Cmd::FmStBandBlendGain, p, 4);
}

/**
 * @brief FMSI stereo/mono bias per audio band.
 * @details FM cmd 92, user manual 3.29. TEF6687/TEF6689 only.
 * @param band1 low band [-250 ... 250 0.1 %, default FM -75]
 * @param band2 2 kHz band [-250 ... 250 0.1 %, default FM -35]
 * @param band3 5 kHz band [-250 ... 250 0.1 %, default FM -24]
 * @param band4 high band [-250 ... 250 0.1 %, default FM -24]
 * @return Error::Ok, or why the write was refused (Error::OutOfRange: see lastErrorParam()).
 */
Error setStBandBlendBias(int16_t band1, int16_t band2, int16_t band3, int16_t band4) {
  const int16_t p[] = {static_cast<int16_t>(band1), static_cast<int16_t>(band2), static_cast<int16_t>(band3), static_cast<int16_t>(band4)};
  return write(tef::Cmd::FmStBandBlendBias, p, 4);
}

/**
 * @brief Audio volume. -60 dB and lower = mute.
 * @details AUDIO cmd 10, user manual 3.30.
 * @param volume -59.9 ... +24 dB [-599 ... 240 0.1 dB, default AUDIO 0]
 * @return Error::Ok, or why the write was refused (Error::OutOfRange: see lastErrorParam()).
 */
Error setVolume(int16_t volume) {
  const int16_t p[] = {static_cast<int16_t>(volume)};
  return write(tef::Cmd::AudioVolume, p, 1);
}

/**
 * @brief Audio mute. The chip starts muted.
 * @details AUDIO cmd 11, user manual 3.31.
 * @param enable mute on/off [0 ... 1, default AUDIO 1]
 * @return Error::Ok, or why the write was refused (Error::OutOfRange: see lastErrorParam()).
 */
Error setMute(bool enable) {
  const int16_t p[] = {static_cast<int16_t>(enable)};
  return write(tef::Cmd::AudioMute, p, 1);
}

/**
 * @brief Audio processor input.
 * @details AUDIO cmd 12, user manual 3.32.
 * @param source Radio / I2sIn / SineGenerator [0 ... 240, default AUDIO 0]
 * @return Error::Ok, or why the write was refused (Error::OutOfRange: see lastErrorParam()).
 */
Error setInput(AudioSource source) {
  const int16_t p[] = {static_cast<int16_t>(source)};
  return write(tef::Cmd::AudioInput, p, 1);
}

/**
 * @brief Route a source directly to an output (bypassing the audio processor).
 * @details AUDIO cmd 13, user manual 3.33.
 * @param output I2sOut / Dac [33 ... 128]
 * @param source AnalogRadio / I2sIn / AudioProcessor / SineGenerator [4 ... 240, default AUDIO 224]
 * @return Error::Ok, or why the write was refused (Error::OutOfRange: see lastErrorParam()).
 */
Error setOutputSource(AudioOutput output, AudioSource source) {
  const int16_t p[] = {static_cast<int16_t>(output), static_cast<int16_t>(source)};
  return write(tef::Cmd::AudioOutputSource, p, 2);
}

/**
 * @brief Analog DAC output on/off.
 * @details AUDIO cmd 21, user manual 3.34.
 * @param output Dac [128 ... 128]
 * @param enable output enabled [0 ... 1, default AUDIO 1]
 * @return Error::Ok, or why the write was refused (Error::OutOfRange: see lastErrorParam()).
 */
Error setAnaOut(AudioOutput output, bool enable) {
  const int16_t p[] = {static_cast<int16_t>(output), static_cast<int16_t>(enable)};
  return write(tef::Cmd::AudioAnaOut, p, 2);
}

/**
 * @brief Gain of the I2S input.
 * @details AUDIO cmd 23, user manual 3.36.
 * @param source Input [32 ... 32]
 * @param gain external source gain [-120 ... 60 0.1 dB, default AUDIO 0]
 * @return Error::Ok, or why the write was refused (Error::OutOfRange: see lastErrorParam()).
 */
Error setInputScaler(I2sSignal source, int16_t gain) {
  const int16_t p[] = {static_cast<int16_t>(source), static_cast<int16_t>(gain)};
  return write(tef::Cmd::AudioInputScaler, p, 2);
}

/**
 * @brief Test tone generator (select it with setInput/setOutputSource).
 * @details AUDIO cmd 24, user manual 3.37.
 * @param mode Off / Wave1Left / Wave2Right / Both / Wave1Stereo / Wave2Stereo / Sum [0 ... 7, default AUDIO 0]
 * @param offset DC offset [-32768 ... 32767 LSB, default AUDIO 0]
 * @param amplitude1 wave 1 level [-300 ... 0 0.1 dB, default AUDIO -200]
 * @param frequency1 wave 1 frequency [10 ... 20000 Hz, default AUDIO 400]
 * @param amplitude2 wave 2 level [-300 ... 0 0.1 dB, default AUDIO -200]
 * @param frequency2 wave 2 frequency [10 ... 20000 Hz, default AUDIO 1000]
 * @return Error::Ok, or why the write was refused (Error::OutOfRange: see lastErrorParam()).
 */
Error setWaveGen(WaveMode mode, int16_t offset, int16_t amplitude1, uint16_t frequency1, int16_t amplitude2, uint16_t frequency2) {
  const int16_t p[] = {static_cast<int16_t>(mode), static_cast<int16_t>(offset), static_cast<int16_t>(amplitude1), static_cast<int16_t>(frequency1), static_cast<int16_t>(amplitude2), static_cast<int16_t>(frequency2)};
  return write(tef::Cmd::AudioWaveGen, p, 6);
}

/**
 * @brief Radio standby (low power, settings kept). A tune also wakes the radio.
 * @details APPL cmd 1, user manual 3.38.
 * @param standby true = radio standby [0 ... 1, default APPL 1]
 * @return Error::Ok, or why the write was refused (Error::OutOfRange: see lastErrorParam()).
 */
Error setOperationMode(bool standby) {
  const int16_t p[] = {static_cast<int16_t>(standby)};
  return write(tef::Cmd::ApplOperationMode, p, 1);
}

